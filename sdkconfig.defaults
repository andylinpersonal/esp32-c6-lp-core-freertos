## sdkconfig.defaults
```kconfig
CONFIG_ESP_SYSTEM_PANIC_PRINT_HALT=y
CONFIG_ESP_CONSOLE_USB_SERIAL_JTAG=y
CONFIG_FREERTOS_WATCHPOINT_END_OF_STACK=y
# CONFIG_COMPILER_SAVE_RESTORE_LIBCALLS=y

# -O0
# CONFIG_COMPILER_OPTIMIZATION_NONE=y
# -OsY
# CONFIG_COMPILER_OPTIMIZATION_SIZE=y
# CONFIG_COMPILER_OPTIMIZATION_ASSERTIONS_ENABLE=y
```

## sdkconfig.defaults.esp32c6
```kconfig
CONFIG_ULP_COPROC_ENABLED=y
CONFIG_ULP_COPROC_TYPE_LP_CORE=y
CONFIG_ULP_COPROC_RESERVE_MEM=16316
CONFIG_ULP_PANIC_OUTPUT_ENABLE=y
```
